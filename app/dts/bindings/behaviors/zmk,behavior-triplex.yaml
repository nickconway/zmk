## app/dts/bindings/behaviors/zmk,behavior-triplex.yaml
```yaml
# Copyright (c) 2022 The ZMK Contributors
# SPDX-License-Identifier: MIT

description: Triplex Behavior

compatible: "zmk,behavior-triplex"

include: zero_param.yaml

properties:
  bindings:
    type: phandle-array
    required: true
  shared-key-positions:
    type: array
    required: false
    default: []
  shared-layers:
    type: array
    required: false
    default: []
```

## app/dts/bindings/input_processors/zmk,input-processor-direction-to-behaviors.yaml
```yaml
# Copyright (c) 2024, The ZMK Contributors
# SPDX-License-Identifier: MIT

description: Input Processor for invoking behaviors on certain events

compatible: "zmk,input-processor-direction-to-behaviors"

include: ip_zero_param.yaml

properties:
    codes:
        type: array
        required: true
    bindings:
        type: phandle-array
        required: true
    invoke-every-ms:
        type: int
        required: false
        default: 0
```

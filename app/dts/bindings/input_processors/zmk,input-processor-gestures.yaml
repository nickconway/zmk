## app/dts/bindings/input_processors/zmk,input-processor-gestures.yaml
```yaml
# Copyright (c) 2024, The ZMK Contributors
# SPDX-License-Identifier: MIT

description: Input Processor for remapping certain gestures to behaviors

compatible: "zmk,input-processor-gestures"

include: ip_zero_param.yaml

properties:
    fingers:
        type: int
        required: true
    codes:
        type: array
        required: true
    bindings:
        type: phandle-array
        required: true
```
